## config/west.yml
```yaml
# 2026-10-12 にビルド・実機データ照合したコミットに固定（更新するときは各ブランチの最新 SHA に差し替えて再ビルド）
manifest:
  defaults:
    remote: cormoran
    revision: main
  remotes:
    - name: cormoran
      url-base: https://github.com/cormoran
    - name: caksoylar
      url-base: https://github.com/caksoylar
  projects:
    - name: zmk
      revision: e5c9b6915b56801193e359dd9bad4a167ce0d1b8 # main+dya (2026-10-12)
      import:
        file: app/west.yml
    - name: zephyr
      revision: 63363d92c475ad203b35e9047cef7ecd8706a6fc # v4.1.0+zmk-fixes+nrf-half-duplex-uart (2026-10-12)
      clone-depth: 1
      import:
        name-blocklist:
          - ci-tools
          - hal_altera
          - hal_cypress
          - hal_infineon
          - hal_microchip
          - hal_nxp
          - hal_openisa
          - hal_xtensa
          - hal_st
          - hal_ti
          - loramac-node
          - mcuboot
          - mcumgr
          - net-tools
          - openthread
          - edtt
          - trusted-firmware-m
    - name: zmk-feature-custom-settings
      revision: c6a7fef3a3be3d3ace5de9a4b0628c6418cd1f3f # main (2026-10-12)
    - name: zmk-feature-fast-keymap
      revision: 8dac76de0ba38588ba39ca498910e24f8332bc6b # main (2026-10-12)
    - name: zmk-feature-runtime-macro
      revision: 38530962eb7061b60efcb98e84585cfb1f0cb6de # main (2026-10-12)
    - name: zmk-feature-runtime-combo
      revision: d9490e7b5d41c516221d131241009e81740efcee # main (2026-10-12)
    - name: zmk-feature-input-stream
      revision: aeb015908a42a7615ccdccc7feb3a10d23132a71 # main (2026-10-12)
    - name: zmk-feature-module-physical-layout
      revision: 4f18de45dc27820725d267916b4cdacc0e0b6cf9 # main (2026-10-12)
    - name: zmk-driver-pmw3610-with-custom-studio-rpc
      revision: 5c34ea0eec246a1c986111417cd779b53144629a # main (2026-10-12)
    - name: zmk-module-runtime-input-processor
      revision: decf628d7ce5ed95b520c650824c28ea9de649c1 # main (2026-10-12)
    - name: zmk-behavior-runtime-sensor-rotate
      revision: 8b1125ed676c1f5e14145d217984f33d0ebdcef4 # main (2026-10-12)
    - name: zmk-module-ble-management
      revision: 57738cc4fc6ba80e82a7ac57741a0339cb186cd4 # main (2026-10-12)
    - name: zmk-module-settings-rpc
      revision: 78f86df9e6c5edaf57bef3ccbd7f360cfdf49291 # main (2026-10-12)
    - name: zmk-feature-default-layer
      revision: b25cb5b324da2d9bbc84e1877c775f5b2b7c6845 # codex/custom-rpc-rewrite (2026-10-12)
      import: true
    - name: zmk-feature-os-detection
      revision: 3052679f645b8fc1997275c2eaa6b86bdd55ca01 # main (2026-10-12)
    - name: zmk-feature-device-info
      revision: 8cedd2dd9f04e19ea5a17b94914dd47a09d8db11 # main (2026-10-12)
    - name: zmk-feature-watchdog
      revision: 84ad14c6c3645dc40b23f45d08ab45418655f912 # main (2026-10-12)
    - name: zmk-feature-kscan-diagnostics
      revision: 1432f7fe0cfe903cd7d3c9931ae6bd6f2e1f328e # main (2026-10-12)
    - name: zmk-rgbled-widget
      revision: e6b467792a1dabef8cfa5c9fd26bfefc9c16662b # main (2026-10-12)
      remote: caksoylar
  self:
    path: config
```
